## target/linux/airoha/en7563/uImage.its
```
/*
 * Simple U-boot uImage source file containing a single kernel and FDT blob
 */

/dts-v1/;

/ {
	description = "Kernel image with single Linux kernel, rootfs and FDT blob";
	#address-cells = <1>;

	images {
		fdt@1 {
			description = "ECONET Flattened Device Tree blob";
			data = /incbin/("ecnt.dtb");
			type = "flat_dt";
			arch = "arm";
			compression = "none";
		};
		kernel@1 {
			description = "ECONET Linux kernel";
			data = /incbin/("linux.7z");
			type = "kernel";
			arch = "arm";
			os = "linux";
			compression = "lzma";
			load = <0x80088000>;
			entry = <0x80088000>;
			hash@1 {
				algo = "sha1";
			};
		};
		filesystem@1 {
			description = "ECONET Root File System";
			data = /incbin/("rootfs");
			type = "filesystem";
			arch = "arm";
			os = "linux";
			compression = "none";
		};
	};

	configurations {
		default = "conf@1";
		conf@1 {
			description = "Boot Linux kernel with FDT blob";
			fdt = "fdt@1";
			kernel = "kernel@1";
			filesystem = "filesystem@1";
		};
	};
};
```
