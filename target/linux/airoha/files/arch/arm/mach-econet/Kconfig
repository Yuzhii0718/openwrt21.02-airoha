## target/linux/airoha/files/arch/arm/mach-econet/Kconfig
```kconfig
config ARCH_ECONET
	bool "ECONET ARM SoC Platforms"
	select ARM_GIC
	select ARM_GIC_V3
	select HAVE_ALIGNED_STRUCT_PAGE
	select ARM_AMBA
	select HAVE_PATA_PLATFORM
	select HAVE_DEBUG_BUGVERBOSE
	select ARM_DMA_USE_IOMMU
	select HAVE_ARM_ARCH_TIMER
	select IOMMU_DMA
	help
		Support for ECONET ARM SoC Platforms
```

## target/linux/airoha/files/drivers/dma/econet/Kconfig
```kconfig
config ECNT_HSDMA
	tristate "ECONET High-Speed DMA controller support"
	depends on ARCH_ECONET || COMPILE_TEST
	select DMA_ENGINE
	select DMA_OF
	select DMA_VIRTUAL_CHANNELS
	---help---
	  Enable support for High-Speed DMA controller on ECONET
	  SoCs.

	  This controller provides the channels which is dedicated to
	  memory-to-memory transfer to offload from CPU through ring-
	  based descriptor management.
```
